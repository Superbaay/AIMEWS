## enbedded/Examples/Camara_12fps_ws/main/Kconfig.projbuild
```kconfig
menu "Camara 12 fps por WebSocket"

    config CAM_WIFI_SSID
        string "Nombre de la red WiFi (SSID)"
        default "mi_red"

    config CAM_WIFI_PASSWORD
        string "Contraseña de la red WiFi"
        default "mi_clave"

    config CAM_API_HOST
        string "IP o dominio de la API (FastAPI)"
        default "192.168.1.100"
        help
            La PC donde corre la API. Arráncala con: uvicorn main:app --host 0.0.0.0
            (con 127.0.0.1 solo acepta conexiones de la misma PC).

    config CAM_API_TLS
        bool "Conectar con TLS (https:// y wss://)"
        default n
        help
            Para una API publicada en internet, p. ej. api.superbaay.dev detrás de un
            túnel de Cloudflare (puerto 443). El certificado se valida con el bundle de
            CAs de ESP-IDF (CONFIG_MBEDTLS_CERTIFICATE_BUNDLE).

    config CAM_API_PORT
        int "Puerto de la API"
        default 443 if CAM_API_TLS
        default 8000

    config CAM_MACHINE_NAME
        string "Nombre de la máquina registrada en la API"
        default "kanan_01"

    config CAM_MACHINE_PASSWORD
        string "Contraseña de la máquina"
        default ""

    config CAM_JPEG_QUALITY
        int "Calidad JPEG inicial (4 = mejor ... 63 = peor)"
        range 4 63
        default 25
        help
            A calidad 12 un UXGA ronda 55 KB (5,3 Mbit/s a 12 fps), más de lo que
            sostiene el WiFi de la ESP32. A 25 baja a ~25 KB. Se puede cambiar en
            vivo desde el panel: {"set": "quality", "value": 20}.

endmenu
```

## enbedded/Examples/Camara_S3_ota_ws/components/esp32s3cam/Kconfig
```kconfig
menu "esp32s3cam: cámara OV3660 en ESP32-S3"

    config ESP32S3CAM_XCLK_KHZ
        int "Reloj XCLK del sensor (kHz)"
        range 6000 24000
        default 20000
        help
            Reloj que la ESP32-S3 entrega al sensor (LEDC). El PLL del OV3660 lo
            multiplica: más XCLK = más SYSCLK = más fps con el mismo PLL.
            En la AI-Thinker 20 MHz degradaba el WiFi; mídelo también en esta placa.

    config ESP32S3CAM_VFLIP
        bool "Voltear la imagen en vertical"
        default y
        help
            El OV3660 sale invertido respecto al OV2640 en la mayoría de placas.
            Compruébalo con una foto.

    config ESP32S3CAM_HMIRROR
        bool "Espejo horizontal"
        default n

    menu "Patillaje (por defecto: Freenove ESP32-S3-WROOM CAM / ESP32-S3-EYE)"
        config ESP32S3CAM_PIN_PWDN
            int "PWDN (-1 = no conectado)"
            default -1
        config ESP32S3CAM_PIN_RESET
            int "RESET (-1 = no conectado)"
            default -1
        config ESP32S3CAM_PIN_XCLK
            int "XCLK"
            default 15
        config ESP32S3CAM_PIN_SIOD
            int "SIOD (SDA del SCCB)"
            default 4
        config ESP32S3CAM_PIN_SIOC
            int "SIOC (SCL del SCCB)"
            default 5
        config ESP32S3CAM_PIN_D7
            int "D7 (Y9)"
            default 16
        config ESP32S3CAM_PIN_D6
            int "D6 (Y8)"
            default 17
        config ESP32S3CAM_PIN_D5
            int "D5 (Y7)"
            default 18
        config ESP32S3CAM_PIN_D4
            int "D4 (Y6)"
            default 12
        config ESP32S3CAM_PIN_D3
            int "D3 (Y5)"
            default 10
        config ESP32S3CAM_PIN_D2
            int "D2 (Y4)"
            default 8
        config ESP32S3CAM_PIN_D1
            int "D1 (Y3)"
            default 9
        config ESP32S3CAM_PIN_D0
            int "D0 (Y2)"
            default 11
        config ESP32S3CAM_PIN_VSYNC
            int "VSYNC"
            default 6
        config ESP32S3CAM_PIN_HREF
            int "HREF"
            default 7
        config ESP32S3CAM_PIN_PCLK
            int "PCLK"
            default 13
    endmenu

endmenu
```

## enbedded/Examples/Camara_S3_ota_ws/main/Kconfig.projbuild
```kconfig
menu "Camara S3 SAMATI: video + OTA"

    config CAM_WIFI_SSID
        string "Red WiFi 1 (p. ej. la de casa)"
        default "mi_red"

    config CAM_WIFI_PASSWORD
        string "Contraseña de la red 1"
        default "mi_clave"

    config CAM_WIFI_SSID_2
        string "Red WiFi 2 (opcional, p. ej. hotspot del teléfono)"
        default ""
        help
            Si se llena, la cámara escanea antes de cada intento y entra a la red
            conocida que vea (la de mejor señal si están las dos). Al perder una,
            vuelve a escanear y pasa a la otra. El ESP32-S3 solo tiene radio de
            2.4 GHz: el hotspot debe estar en 2.4 GHz.

    config CAM_WIFI_PASSWORD_2
        string "Contraseña de la red 2"
        default ""

    config CAM_API_HOST
        string "IP o dominio de la API (FastAPI)"
        default "api.superbaay.dev"
        help
            Por defecto la API publicada por el túnel de Cloudflare (sirve desde
            cualquier red, también el hotspot del teléfono). Para una PC de la red
            local pon su IP, desactiva TLS y usa el puerto de uvicorn.

    config CAM_API_TLS
        bool "Conectar con TLS (https:// y wss://)"
        default y

    config CAM_API_PORT
        int "Puerto de la API"
        default 443 if CAM_API_TLS
        default 8001

    config CAM_MACHINE_NAME
        string "Nombre de la máquina registrada en la API"
        default "dron_camera_01"

    config CAM_MACHINE_PASSWORD
        string "Contraseña de la máquina"
        default ""

    config CAM_MODE
        string "Modo de la cámara al arrancar (librería esp32s3cam)"
        default "HD30"
        help
            VGA60, XGA30, HD30, HD45 o FHD22. Todos verificados en la placa.
            HD30 = 1280x720 sin pérdidas de frames con cualquier escena.

    config CAM_FPS
        int "Frames por segundo que se mandan a la API"
        range 1 15
        default 12
        help
            La API (camera_rt.py) acepta como mucho 15 fps por cámara y descarta
            el resto. La cámara captura más rápido; se manda el frame más reciente.

    config CAM_JPEG_QUALITY
        int "Calidad JPEG inicial (4 = mejor ... 63 = más compresión)"
        range 4 63
        default 25
        help
            HD a q25 ronda 20 KB por frame: 12 fps = ~2 Mbit/s, que caben por el
            hotspot del teléfono. Se cambia en vivo desde el panel (set quality).

endmenu
```

## enbedded/Examples/Dron_telemetria_ws/main/Kconfig.projbuild
```kconfig
menu "Dron SAMATI: telemetría por WebSocket"

    config DRON_WIFI_SSID
        string "Nombre de la red WiFi (SSID)"
        default "mi_red"

    config DRON_WIFI_PASSWORD
        string "Contraseña de la red WiFi"
        default "mi_clave"

    config DRON_API_HOST
        string "IP o dominio de la API (FastAPI)"
        default "api.superbaay.dev"
        help
            Por defecto la API publicada por el túnel de Cloudflare. Para una PC
            de la red local pon su IP, desactiva TLS y usa el puerto de uvicorn
            (arrancado con --host 0.0.0.0).

    config DRON_API_TLS
        bool "Conectar con TLS (https:// y wss://)"
        default y

    config DRON_API_PORT
        int "Puerto de la API"
        default 443 if DRON_API_TLS
        default 8001

    config DRON_MACHINE_NAME
        string "Nombre de la máquina registrada en la API"
        default "kanan_01"

    config DRON_MACHINE_PASSWORD
        string "Contraseña de la máquina"
        default ""

    config DRON_TELEMETRIA_HZ
        int "Mensajes de telemetría por segundo hacia el panel"
        range 1 50
        default 10
        help
            Los sensores se leen a su ritmo (IMU 1000 Hz, barómetro ~89 Hz,
            GPS 5 Hz); esto es solo cuántas veces por segundo se manda la
            última lectura al panel. Una pantalla no necesita más de 10-20.

endmenu
```
